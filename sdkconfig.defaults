## sdkconfig.defaults
```kconfig
# ESP-IDF Log Level Configuration
# This reduces the verbosity of ESP-IDF system components

# Set default log level to WARNING (only show warnings and errors from system)
CONFIG_LOG_DEFAULT_LEVEL_WARN=y
CONFIG_LOG_DEFAULT_LEVEL=2

# Set maximum log level to INFO (allows your app to still use ESP_LOGI)
CONFIG_LOG_MAXIMUM_LEVEL_INFO=y
CONFIG_LOG_MAXIMUM_LEVEL=3

# Disable verbose boot messages
CONFIG_BOOTLOADER_LOG_LEVEL_WARN=y
CONFIG_BOOTLOADER_LOG_LEVEL=2

# Reduce component-specific logs
CONFIG_LOG_DEFAULT_LEVEL_WIFI=1
CONFIG_LOG_DEFAULT_LEVEL_PHY=1
CONFIG_LOG_DEFAULT_LEVEL_ESP_NETIF=1
CONFIG_LOG_DEFAULT_LEVEL_SPI_FLASH=1

# Disable boot logo
CONFIG_BOOTLOADER_COMPILER_OPTIMIZATION_SIZE=y
```
